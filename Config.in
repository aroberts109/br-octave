## Config.in
```kconfig
source "$BR2_EXTERNAL_OCTAVE_SUPPORT_PATH/package/octave/Config.in"
source "$BR2_EXTERNAL_OCTAVE_SUPPORT_PATH/package/octave/Config.host.in"
source "$BR2_EXTERNAL_OCTAVE_SUPPORT_PATH/package/octave-control/Config.in"
source "$BR2_EXTERNAL_OCTAVE_SUPPORT_PATH/package/octave-signal/Config.in"
```

## package/octave-signal/Config.in
```kconfig
config BR2_PACKAGE_OCTAVE_SIGNAL
	bool "octave signal"
	depends on BR2_PACKAGE_OCTAVE
	select BR2_PACKAGE_OCTAVE_CONTROL
	help
      Signal processing tools, including filtering, windowing and display functions.

	  https://octave.sourceforge.io/signal/index.html
```

## package/octave/Config.in
```kconfig
config BR2_PACKAGE_OCTAVE
	bool "Octave"
	depends on BR2_PACKAGE_FFTW
	select BR2_PACKAGE_OPENBLAS
	select BR2_PACKAKE_LAPACK
	select BR2_PACKAGE_PCRE
	select BR2_PACKAGE_READLINE
	select BR2_PACKAGE_LIBCURL_CURL

	help
	  GNU Octave

	  https://wiki.octave.org/Building
```
